## drivers/rtio/Kconfig
```kconfig
# Kconfig - rtio configuration options

#
# Copyright (c) 2019 Tom Burdick <tom.burdick@electromatic.us>
# Copyright (c) 2020 Nordic Semiconductor ASA
#
# SPDX-License-Identifier: Apache-2.0
#

menuconfig RTIO
	bool "RTIO Drivers"
	select NET_BUF
	help
	  Include rtio drivers in system config

if RTIO

module = RTIO
module-str = rtio
source "subsys/logging/Kconfig.template.log_config"

config RTIO_INIT_PRIORITY
	int "RTIO init priority"
	default 90
	help
	  RTIO initialization priority.

config RTIO_CONTEXT
	# Private option; will be selected by the drivers if
	# this feature is required.
	bool

comment "Sensor Drivers"

config RTIO_HTS221
	bool "HTS221 temperature and humidity driver"
	depends on I2C
	select RTIO_CONTEXT
	help
	  Enable the RTIO sensor driver for the HTS221 temperature and
	  relative humidity sensor.

comment "API Example Drivers"

config RTIO_RAMP
	bool "RTIO ramp driver"
	select RTIO_CONTEXT
	help
	  RTIO ramp driver

endif # RTIO
```
