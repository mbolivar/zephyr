/*
 * Copyright (c) 2019, Nordic Semiconductor ASA
 *
 * SPDX-License-Identifier: Apache-2.0
 */

#include <dt-bindings/gpio/gpio.h>

/ {
	led_strip: ws2812 {
		compatible = "worldsemi,ws2812-gpio";
		label = "WS2812";

		chain-length = <16>; /* arbitrary; change at will */
		/* arduino D0: */
		in-gpios = <&gpio0 12 0>;
	};

	aliases {
		led-strip = &led_strip;
	};
};
